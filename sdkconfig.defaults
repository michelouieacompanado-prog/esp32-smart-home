## sdkconfig.defaults
```kconfig
# Flash and Partition Settings
CONFIG_ESPTOOLPY_FLASHSIZE_4MB=y
CONFIG_PARTITION_TABLE_CUSTOM=y
CONFIG_PARTITION_TABLE_CUSTOM_FILENAME="partitions.csv"
CONFIG_PARTITION_TABLE_FILENAME="partitions.csv"

# FreeRTOS Configuration & IRAM optimizations
CONFIG_FREERTOS_VTASKLIST_INCLUDE_COREID=y
CONFIG_FREERTOS_GENERATE_RUN_TIME_STATS=n
CONFIG_FREERTOS_PLACE_FUNCTIONS_INTO_FLASH=y
CONFIG_RINGBUF_PLACE_FUNCTIONS_INTO_FLASH=y

# Wi-Fi IRAM optimizations
CONFIG_ESP_WIFI_IRAM_OPT=n
CONFIG_ESP_WIFI_RX_IRAM_OPT=n

# mbedTLS memory optimizations
CONFIG_MBEDTLS_DYNAMIC_BUFFER=y
CONFIG_MBEDTLS_DYNAMIC_FREE_PEER_CERT=y
CONFIG_MBEDTLS_DYNAMIC_FREE_CONFIG_DATA=y
CONFIG_MBEDTLS_CERTIFICATE_BUNDLE_DEFAULT_CMN=y

# Bluetooth: use NimBLE (BLE only) to save IRAM and DRAM
CONFIG_BT_ENABLED=y
CONFIG_BTDM_CTRL_MODE_BLE_ONLY=y
CONFIG_BT_BLE_ENABLED=y
CONFIG_BT_NIMBLE_ENABLED=y

# ESP RainMaker Configuration
CONFIG_ESP_RMAKER_TASK_STACK=4096
CONFIG_ESP_RMAKER_DEF_TIMEZONE="UTC"
CONFIG_ESP_RMAKER_MQTT_PORT_443=y

# Main Task Stack Size
CONFIG_ESP_MAIN_TASK_STACK_SIZE=8192

# Compiler optimization
CONFIG_COMPILER_OPTIMIZATION_DEFAULT=y
```
